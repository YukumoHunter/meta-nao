## meta-hulks/conf/distro/HULKs-DNT-OS.conf
```bitbake
require conf/distro/nao-core-minimal.conf

SUMMARY = "HULKs flavoured Nao"

DISTRO = "HULKs-DNT-OS"
DISTRO_NAME = "HULKs-DNT-OS"
DISTRO_VERSION = "9.0.0"
SDKIMAGE_FEATURES:remove = "dbg-pkgs src-pkgs"
```
